## drivers/kprofiles/Kconfig
```kconfig
# SPDX-License-Identifier: GPL-2.0
#
# Copyright (C) 2021-2023 Dakkshesh <dakkshesh5@gmail.com>.

config KPROFILES
	tristate "Kprofiles Kernel Module"
	depends on CPU_FREQ
	default y
	help
	  Expose Disabled, Battery, Balanced and Performance profiles through
	  sysfs. CPU limits use independent frequency QoS requests and follow
	  cpufreq policy creation and removal. The QTI devfreq cooling driver
	  can apply a separate GPU battery ceiling.

	  Thermal and userspace constraints remain independent. See
	  drivers/kprofiles/README.md for the ABI and profile policy.

if KPROFILES

config KP_DEFAULT_MODE
	int "Default mode number for kp_mode"
	range 0 3
	default 2
	help
	  Kprofiles will activate this mode during boot-up.

endif # KPROFILES
```
